## boards/shields/osrpey-remix/Kconfig.defconfig
```kconfig
# Copyright (c) 2020 The ZMK Contributors
# SPDX-License-Identifier: MIT

if Osprey-remix

config ZMK_KEYBOARD_NAME
    default "Osprey-Remix"

endif
```

## config/boards/shields/osprey-remix/Kconfig.defconfig
```kconfig
# Copyright (c) 2020 The ZMK Contributors
# SPDX-License-Identifier: MIT

if SHIELD_OSPREY-REMIX

config ZMK_KEYBOARD_NAME
    default "Osprey Remix"

endif
```

## config/boards/shields/osprey-remix/Kconfig.shield
```kconfig
# Copyright (c) 2020 The ZMK Contributors
# SPDX-License-Identifier: MIT

config SHIELD_OSPREY-REMIX
    def_bool $(shields_list_contains,my_board)
```
